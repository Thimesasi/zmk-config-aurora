## config/boards/shields/aurora/Kconfig.defconfig
```kconfig
if AURORA_LEFT_SHIELD || AURORA_RIGHT_SHIELD

config ZMK_SPLIT
    default y

endif

if AURORA_DONGLE_SHIELD

config ZMK_KEYBOARD_NAME
    default "Aurora"

config ZMK_SPLIT_ROLE_CENTRAL
    default y

config ZMK_SPLIT
    default y

endif
```

## config/boards/shields/aurora/Kconfig.shield
```kconfig
config AURORA_DONGLE_SHIELD
    def_bool $(shields_list_contains,aurora_dongle)

config AURORA_LEFT_SHIELD
    def_bool $(shields_list_contains,aurora_left)

config AURORA_RIGHT_SHIELD
    def_bool $(shields_list_contains,aurora_right)
```

## config/west.yml
```yaml
manifest:
  remotes:
    - name: zmkfirmware
      url-base: https://github.com/zmkfirmware
    - name: niceviewflip
      url-base: https://github.com/invrtd
  projects:
    - name: zmk
      remote: niceviewflip
      revision: nice!view-180
      import: app/west.yml
  self:
    path: config
```
